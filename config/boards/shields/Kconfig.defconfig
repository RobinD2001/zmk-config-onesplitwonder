## config/boards/shields/Kconfig.defconfig
```kconfig
if SHIELD_OSW_LEFT

config ZMK_KEYBOARD_NAME
    default "One-Split Wonder"

config ZMK_SPLIT_ROLE_CENTRAL
    default y

endif

if SHIELD_OSW_LEFT || SHIELD_OSW_RIGHT

config ZMK_SPLIT
    default y

endif
```

## config/boards/shields/onesplitwonder/Kconfig.shield
```kconfig
config SHIELD_OSW_LEFT
    def_bool $(shields_list_contains,onesplitwonder_left)

config SHIELD_OSW_RIGHT
    def_bool $(shields_list_contains,onesplitwonder_right)
```
